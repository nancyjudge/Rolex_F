## arch/arm64/hotplug/Kconfig
```kconfig
config MSM_HOTPLUG
	bool "MSM hotplug by [Fluxi]"
	depends on HOTPLUG_CPU
	default n
	help
	  The MSM hotplug driver controls on-/offlining of additional cores based on current cpu load

config ALUCARD_HOTPLUG
	bool "Alucard hotplug"
	default n
	help
	  Generic Alucard-hotplug cpu hotplug driver for ARM SOCs

config THUNDERPLUG_CONTROL
	bool "Thunderplug plugging down/up of cores based on load per core"
	depends on SMP && HOTPLUG_CPU
	default n
	help
	  This driver hotplugs cpu cores based on per-core load

config BLU_PLUG
	bool "Dynamic hotplug driver"
	depends on HOTPLUG_CPU
	default n
	help
	  The Dynamic hotplug driver automatically online/offline CPUs proportional to system load.

config AUTOSMP
	bool "Multi-core automatic hotplug support"
	depends on SMP && HOTPLUG_CPU
	default n
	help
	  Automatically hotplugs the multiple cpu cores on and off
	  based on cpu load and suspend statte.
```
